## board/seco/SBC_A62/Kconfig
```kconfig
if TARGET_MX6QDL_SECO_SBC_A62

config SYS_BOARD
        default "SBC_A62"

config SYS_VENDOR
        default "seco"

config SYS_CONFIG_NAME
        default "mx6qdl_seco_sbc_a62"

config SYS_TEXT_BASE
    default 0x17800000

endif
```
